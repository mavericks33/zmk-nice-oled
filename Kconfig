## Kconfig
```kconfig
if ZMK_BEHAVIORS
config ZMK_BEHAVIOR_DISPLAY_TOGGLE
    bool "Display toggle behavior"
    default y
config ZMK_BEHAVIOR_DISPLAY_TOGGLE_IDLE_MS
    int "Display auto-off idle timeout (ms)"
    default 30000
    depends on ZMK_BEHAVIOR_DISPLAY_TOGGLE
endif
```

## dts/bindings/behaviors/zmk,behavior-display-toggle.yaml
```yaml
description: Display Toggle Behavior
compatible: "zmk,behavior-display-toggle"
include: zero_param.yaml
```
